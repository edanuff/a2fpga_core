// Co-simulation of the REAL a2mega sound chain (rev 3.9+):
//
//   chain A (DUT):  sound_glu (USE_BSRAM=0, USE_DDR3_PIPELINED=1)
//                   -> mem_port_if x2 -> ddr3_port_cdc / ddr3_ports (real
//                   RTL, async 54/81 MHz) -> behavioral DDR3 IP model at
//                   the cmd/rd_data interface (~35 clk_ddr read latency,
//                   in-order, single 128-bit beat per read cmd).
//   chain B (ref):  sound_glu (USE_BSRAM=1) — the audibly-proven
//                   configuration — same host stimulus, ensoniq_bsram.
//
// Both chains hang off ONE real a2bus_if (GLU register decode, write
// queue, DOC host path all in the loop — the previously-unsimulated
// integration seam). The comparison is the final audio_l/r_o streams,
// bringing the mixer/volume path into the differential for the first
// time. Every DUT file is unmodified repo RTL.
//
// Phases: wavetable upload; steady 2-oscillator playback (bit-equality
// required); sample-RAM streaming during playback (bounded staleness,
// must re-converge); retriggers on a running oscillator (bounded, must
// re-converge); module reset with the DDR3 chain live (Apple RESET
// semantics — CDC/arbiter state survives; drain gate must protect the
// re-primes); final steady equality.
//
// Build: verilator --binary --timing (see run.sh cosim leg).

`timescale 1ns/1ps

module tb_cosim;

    // ---------------------------------------------------------------------
    // Clocks: 54 MHz client, 81 MHz DDR, asynchronous phases
    // ---------------------------------------------------------------------
    reg clk_logic = 0;
    always #9.259 clk_logic = ~clk_logic;
    reg clk_ddr = 0;
    initial begin
        #3.7;
        forever #6.173 clk_ddr = ~clk_ddr;
    end

    reg ddr_rst = 1;
    reg init_complete = 0;
    initial begin
        repeat (20) @(posedge clk_ddr);
        ddr_rst = 0;
        repeat (50) @(posedge clk_ddr);
        init_complete = 1;
    end

    // ---------------------------------------------------------------------
    // Apple II bus (real interface, minimal but real drive)
    // ---------------------------------------------------------------------
    a2bus_if a2bus ();

    reg sys_rst_n = 0;
    assign a2bus.clk_logic = clk_logic;
    assign a2bus.system_reset_n = sys_rst_n;
    assign a2bus.device_reset_n = sys_rst_n;
    assign a2bus.phi0 = 1'b1;
    assign a2bus.m2sel_n = 1'b0;

    // 7.159 MHz clock-enable DDS (as generated by the real bus timing)
    reg clk7_en = 0;
    integer dds_acc = 0;
    always @(posedge clk_logic) begin
        if (dds_acc + 7159090 >= 54000000) begin
            dds_acc <= dds_acc + 7159090 - 54000000;
            clk7_en <= 1;
        end else begin
            dds_acc <= dds_acc + 7159090;
            clk7_en <= 0;
        end
    end
    assign a2bus.clk_7M_posedge = clk7_en;

    reg [15:0] bus_addr = 0;
    reg [7:0]  bus_data = 0;
    reg        bus_rw_n = 1;
    reg        bus_strobe = 0;
    assign a2bus.addr = bus_addr;
    assign a2bus.data = bus_data;
    assign a2bus.rw_n = bus_rw_n;
    assign a2bus.data_in_strobe = bus_strobe;

    task bus_write(input [15:0] a, input [7:0] d);
        begin
            @(negedge clk_logic);
            bus_addr = a; bus_data = d; bus_rw_n = 0;
            @(negedge clk_logic);
            bus_strobe = 1;
            @(negedge clk_logic);
            bus_strobe = 0; bus_rw_n = 1;
            // ~1 MHz bus cadence
            repeat (50) @(posedge clk_logic);
        end
    endtask

    // GLU helpers ($C03C-$C03F)
    task glu_ctrl(input [7:0] v);    bus_write(16'hC03C, v); endtask
    task glu_ptr(input [15:0] p);
        begin bus_write(16'hC03E, p[7:0]); bus_write(16'hC03F, p[15:8]); end
    endtask
    task ram_byte(input [7:0] d);    bus_write(16'hC03D, d); endtask
    task doc_reg(input [7:0] r, input [7:0] d);
        begin bus_write(16'hC03E, r); bus_write(16'hC03D, d); end
    endtask

    // ---------------------------------------------------------------------
    // Chain A: pipelined DDR3 path with the REAL CDC + arbiter
    //   port 0 = DOC read (higher priority), port 1 = GLU write
    // ---------------------------------------------------------------------
    mem_port_if #(.PORT_ADDR_WIDTH(21), .DATA_WIDTH(32), .DQM_WIDTH(4),
                  .PORT_OUTPUT_WIDTH(32)) ports [0:1] ();

    wire [7:0]  a_data_o;
    wire [15:0] a_audio_l, a_audio_r;
    wire [7:0]  a_prime, a_stale, a_drop;
    wire [15:0] a_fetch_count;
    wire [7:0]  a_frame_resync;
    wire [15:0] a_req_count;
    wire [7:0]  a_req_mingap;

    sound_glu #(
        .ENABLE(1'b1),
        .MONO_MIX(1'b0),
        .USE_BSRAM(1'b0),
        .USE_DDR3_PIPELINED(1'b1),
        .DOC_BANKS_IN_BSRAM(1'b1),
        .GLU_WR_ACK_AVAIL(1'b1)     // a2mega config: DDR3 CDC has no write-ready
    ) glu_pipe (
        .a2bus_if(a2bus),
        .data_o(a_data_o),
        .rd_en_o(),
        .audio_l_o(a_audio_l),
        .audio_r_o(a_audio_r),
        .debug_osc_en_o(),
        .debug_osc_mode_o(),
        .debug_osc_halt_o(),
        .glu_mem_if(ports[1]),
        .doc_mem_if(ports[0]),
        .fb_fetch_active_i(1'b0),
        .glu_wq_drops_o(),
        .dbg_doc_prime_miss_o(a_prime),
        .dbg_doc_stale_fetch_o(a_stale),
        .dbg_doc_fetch_drop_o(a_drop),
        .dbg_doc_fetch_count_o(a_fetch_count),
        .dbg_doc_frame_resync_o(a_frame_resync),
        .dbg_frame_tick_i(1'b0),
        .dbg_doc_req_count_o(a_req_count),
        .dbg_doc_req_mingap_o(a_req_mingap)
    );

    // Real arbiter + CDC (2 ports)
    wire        d_cmd_ready = 1'b1;
    wire [2:0]  d_cmd;
    wire        d_cmd_en;
    wire [28:0] d_addr;
    wire        d_wr_data_rdy = 1'b1;
    wire [127:0] d_wr_data;
    wire        d_wr_data_en;
    wire        d_wr_data_end;
    wire [15:0] d_wr_data_mask;
    reg         d_rd_valid = 0;
    reg [127:0] d_rd_data = 0;

    ddr3_ports #(
        .NUM_PORTS(2),
        .PORT_ADDR_WIDTH(21),
        .DATA_WIDTH(32),
        .DQM_WIDTH(4),
        // PORT_BASE_ADDR left at its default '{NUM_PORTS{0}} (all-zero
        // bases) — overriding the dependent-size array trips a Verilator
        // elaboration quirk, and zero is what this bench wants anyway.
        .WIDE_WR_PORT(-1),
        .READ_BURST8_PORT(-1)
    ) u_arb (
        .clk_client(clk_logic),
        .clk_ddr(clk_ddr),
        .rst(ddr_rst),
        .init_complete(init_complete),
        .ports(ports),
        .cmd_ready(d_cmd_ready),
        .cmd(d_cmd),
        .cmd_en(d_cmd_en),
        .addr(d_addr),
        .wr_data_rdy(d_wr_data_rdy),
        .wr_data(d_wr_data),
        .wr_data_en(d_wr_data_en),
        .wr_data_end(d_wr_data_end),
        .wr_data_mask(d_wr_data_mask),
        .wide_wr_data_hi(96'd0),
        .rd_data_valid(d_rd_valid),
        .rd_data(d_rd_data),
        .rd_data_end(d_rd_valid),
        .dbg_req_pending(),
        .dbg_arb_state(),
        .dbg_resp_overflow(),
        .dbg_test_result(),
        .dbg_test_done()
    );

    // ---------------------------------------------------------------------
    // Behavioral DDR3 IP model (clk_ddr domain): ~35-cycle read latency,
    // in-order, one 128-bit beat per read; masked writes applied at cmd.
    // ---------------------------------------------------------------------
    localparam DMEM_WORDS = 1 << 19;   // 8 MB span covers the loopback test
    reg [127:0] dmem [0:DMEM_WORDS-1];
    integer di;
    initial for (di = 0; di < DMEM_WORDS; di = di + 1) dmem[di] = '0;

    localparam RD_Q = 8;
    reg [28:0] rq_addr [0:RD_Q-1];
    integer    rq_due  [0:RD_Q-1];
    reg [2:0]  rq_hd = 0, rq_tl = 0;
    integer    rq_n = 0;
    integer    dcyc = 0;
    integer    rd_lat;
    integer    dseed = 7;

    always @(posedge clk_ddr) begin
        integer b;
        dcyc <= dcyc + 1;
        d_rd_valid <= 0;
        if (!ddr_rst) begin
            if (d_cmd_en && d_cmd == 3'b000 && d_wr_data_en) begin
                for (b = 0; b < 16; b = b + 1)
                    if (!d_wr_data_mask[b])
                        dmem[d_addr[28:4] % DMEM_WORDS][8*b +: 8] <= d_wr_data[8*b +: 8];
            end
            if (d_cmd_en && d_cmd == 3'b001) begin
                rd_lat = 32 + ({$random(dseed)} % 8);
                rq_addr[rq_tl] <= d_addr;
                rq_due[rq_tl]  <= dcyc + rd_lat;
                rq_tl <= rq_tl + 3'd1;
                rq_n <= rq_n + 1 - ((rq_n > 0 && dcyc >= rq_due[rq_hd]) ? 1 : 0);
            end else if (rq_n > 0 && dcyc >= rq_due[rq_hd]) begin
                rq_n <= rq_n - 1;
            end
            if (rq_n > 0 && dcyc >= rq_due[rq_hd]) begin
                d_rd_data <= dmem[rq_addr[rq_hd][28:4] % DMEM_WORDS];
                d_rd_valid <= 1;
                rq_hd <= rq_hd + 3'd1;
            end
        end
    end

    // ---------------------------------------------------------------------
    // Chain B: BSRAM reference (audibly proven)
    // ---------------------------------------------------------------------
    mem_port_if #(.PORT_ADDR_WIDTH(21), .DATA_WIDTH(32), .DQM_WIDTH(4),
                  .PORT_OUTPUT_WIDTH(32)) refports [0:1] ();
    assign refports[0].available = 1'b0;
    assign refports[0].ready = 1'b0;
    assign refports[0].q = 32'd0;
    assign refports[1].available = 1'b0;
    assign refports[1].ready = 1'b0;
    assign refports[1].q = 32'd0;

    wire [15:0] b_audio_l, b_audio_r;

    sound_glu #(
        .ENABLE(1'b1),
        .MONO_MIX(1'b0),
        .USE_BSRAM(1'b1),
        .USE_DDR3_PIPELINED(1'b0)
    ) glu_ref (
        .a2bus_if(a2bus),
        .data_o(),
        .rd_en_o(),
        .audio_l_o(b_audio_l),
        .audio_r_o(b_audio_r),
        .debug_osc_en_o(),
        .debug_osc_mode_o(),
        .debug_osc_halt_o(),
        .glu_mem_if(refports[1]),
        .doc_mem_if(refports[0]),
        .fb_fetch_active_i(1'b0),
        .glu_wq_drops_o(),
        .dbg_doc_prime_miss_o(),
        .dbg_doc_stale_fetch_o(),
        .dbg_doc_fetch_drop_o(),
        .dbg_doc_fetch_count_o(),
        .dbg_doc_frame_resync_o(),
        .dbg_frame_tick_i(1'b0),
        .dbg_doc_req_count_o(),
        .dbg_doc_req_mingap_o()
    );

    // ---------------------------------------------------------------------
    // Audio comparison: per-scan mismatch accounting (scan tick from the
    // reference DOC's slot machine; both slot machines are lockstep by
    // construction — asserted below as well).
    // ---------------------------------------------------------------------
    integer scan_count = 0;
    integer scan_mismatch = 0;
    integer phase_scans = 0;
    integer phase_mm = 0;
    reg scan_flag = 0;
    integer cadence_errs = 0;

    wire ref_scan_tick = glu_ref.gen_doc_baseline.doc5503.cycle_start_r
        && (glu_ref.gen_doc_baseline.doc5503.cycle_state_r == 2'b11);

    always @(posedge clk_logic) begin
        if (sys_rst_n) begin
            // Slot-machine lockstep (cadence class)
            if (glu_ref.gen_doc_baseline.doc5503.cycle_start_r
                !== glu_pipe.gen_doc_pipelined.doc5503.cycle_start_r
             || glu_ref.gen_doc_baseline.doc5503.cycle_state_r
                !== glu_pipe.gen_doc_pipelined.doc5503.cycle_state_r)
                cadence_errs <= cadence_errs + 1;

            if (a_audio_l !== b_audio_l || a_audio_r !== b_audio_r)
                scan_flag <= 1;
            if (ref_scan_tick) begin
                scan_count <= scan_count + 1;
                phase_scans <= phase_scans + 1;
                if (scan_flag || a_audio_l !== b_audio_l
                              || a_audio_r !== b_audio_r) begin
                    scan_mismatch <= scan_mismatch + 1;
                    phase_mm <= phase_mm + 1;
                end
                scan_flag <= 0;
            end
        end
    end

    task wait_scans(input integer n);
        integer i;
        begin
            for (i = 0; i < n; i = i + 1) begin
                @(posedge clk_logic);
                while (!ref_scan_tick) @(posedge clk_logic);
            end
        end
    endtask

    integer fails = 0;
    task phase_check(input [8*24-1:0] name, input integer budget,
                     input integer tail_clean);
        begin
            $display("PHASE %0s: %0d/%0d mismatch scans (budget %0d)",
                     name, phase_mm, phase_scans, budget);
            if (phase_mm > budget) begin
                $display("  ** BUDGET EXCEEDED **");
                fails = fails + 1;
            end
            phase_mm = 0;
            phase_scans = 0;
            if (tail_clean) begin
                wait_scans(20);
                if (phase_mm != 0) begin
                    $display("  ** NOT RE-CONVERGED: %0d mismatch scans in tail **", phase_mm);
                    fails = fails + 1;
                end
                phase_mm = 0;
                phase_scans = 0;
            end
        end
    endtask

    // ---------------------------------------------------------------------
    // Test sequence
    // ---------------------------------------------------------------------
    integer k;
    initial begin
        repeat (40) @(posedge clk_logic);
        sys_rst_n = 1;
        // wait for DDR3 init + arbiter loopback test to finish
        repeat (600) @(posedge clk_logic);

        // ---- upload a 256-byte wavetable to sound RAM 0x0000 ----
        glu_ctrl(8'h60);                // RAM access + auto-increment
        glu_ptr(16'h0000);
        for (k = 0; k < 256; k = k + 1)
            ram_byte(8'h40 + (k[7:0] & 8'h3F));
        // second table at 0x0100 for osc1
        for (k = 0; k < 256; k = k + 1)
            ram_byte(8'((k[7:0] * 3 + 1) | 8'h01));

        // ---- configure the DOC (register access) ----
        glu_ctrl(8'h00);                // DOC access
        doc_reg(8'hE1, 8'h04);          // osc_max = 2
        doc_reg(8'h00, 8'h00); doc_reg(8'h20, 8'h02);   // osc0 FC=0x0200
        doc_reg(8'h40, 8'hFF);                          // vol
        doc_reg(8'h80, 8'h00); doc_reg(8'hC0, 8'h00);   // T0, 256B
        doc_reg(8'h01, 8'h33); doc_reg(8'h21, 8'h03);   // osc1 FC=0x0333
        doc_reg(8'h41, 8'hC0);
        doc_reg(8'h81, 8'h01); doc_reg(8'hC1, 8'h00);   // T1
        wait_scans(30);                 // prime window
        phase_mm = 0; phase_scans = 0; scan_flag = 0;

        // ---- P1: steady playback — must be bit-equal ----
        doc_reg(8'hA0, 8'h00);          // osc0 run
        doc_reg(8'hA1, 8'h10);          // osc1 run, ca=1
        wait_scans(50);
        $display("DBG scans=%0d A:l=%0d r=%0d halt=%02x en=%02x  B:l=%0d r=%0d halt=%02x en=%02x  fetches=%0d avail=%b",
                 scan_count,
                 $signed(a_audio_l), $signed(a_audio_r),
                 glu_pipe.gen_doc_pipelined.doc5503.debug_osc_halt_o,
                 glu_pipe.gen_doc_pipelined.doc5503.osc_en_r,
                 $signed(b_audio_l), $signed(b_audio_r),
                 glu_ref.gen_doc_baseline.doc5503.debug_osc_halt_o,
                 glu_ref.gen_doc_baseline.doc5503.osc_en_r,
                 a_fetch_count, ports[0].available);
        $display("DBG A osc0: acc=%06x ctl=%02x  cacheV=%b prime_pending=%b drain=%b fqw=%0d fqi=%0d fqr=%0d",
                 glu_pipe.gen_doc_pipelined.doc5503.gen_banks_bsram.acc_ram.mem[0],
                 glu_pipe.gen_doc_pipelined.doc5503.gen_banks_bsram.control_ram.mem[0],
                 glu_pipe.gen_doc_pipelined.doc5503.cache_valid_r[1:0],
                 glu_pipe.gen_doc_pipelined.doc5503.prime_pending_r[2:0],
                 glu_pipe.gen_doc_pipelined.doc5503.drain_done_r,
                 glu_pipe.gen_doc_pipelined.doc5503.fq_wr_ptr_r,
                 glu_pipe.gen_doc_pipelined.doc5503.fq_issue_ptr_r,
                 glu_pipe.gen_doc_pipelined.doc5503.fq_ret_ptr_r);
        wait_scans(350);
        phase_check("steady", 0, 0);

        // ---- P2: sample-RAM streaming during playback ----
        glu_ctrl(8'h60);
        glu_ptr(16'h0040);
        for (k = 0; k < 96; k = k + 1)
            ram_byte(8'h80 | k[6:0]);
        glu_ctrl(8'h00);
        wait_scans(60);
        phase_check("stream-writes", 90, 1);

        // ---- P3: retriggers on the RUNNING oscillator ----
        for (k = 0; k < 8; k = k + 1) begin
            doc_reg(8'hA0, 8'h00);      // retrigger (halt=0 on running osc)
            wait_scans(25);
        end
        phase_check("retriggers", 40, 1);

        // ---- P4: module reset with the DDR3 chain LIVE (Apple RESET) ----
        @(negedge clk_logic);
        sys_rst_n = 0;
        repeat (12) @(posedge clk_logic);
        @(negedge clk_logic);
        sys_rst_n = 1;
        // drain window (~19 us) + re-init
        repeat (1400) @(posedge clk_logic);
        glu_ctrl(8'h00);
        doc_reg(8'hE1, 8'h04);
        doc_reg(8'h00, 8'h00); doc_reg(8'h20, 8'h02); doc_reg(8'h40, 8'hFF);
        wait_scans(30);
        phase_mm = 0; phase_scans = 0; scan_flag = 0;
        doc_reg(8'hA0, 8'h00);
        wait_scans(300);
        phase_check("post-reset", 0, 0);

        $display("COSIM: %0d/%0d total mismatch scans, cadence_errs=%0d",
                 scan_mismatch, scan_count, cadence_errs);
        $display("COSIM pipe counters: prime=%0d stale=%0d drop=%0d fetches=%0d reqs=%0d mingap=%0d frsync=%0d",
                 a_prime, a_stale, a_drop, a_fetch_count, a_req_count, a_req_mingap, a_frame_resync);
        if (cadence_errs != 0) begin
            $display("** cadence lockstep violated in co-sim **");
            fails = fails + 1;
        end
        if (a_drop != 0) begin
            $display("** fetch drops in co-sim **");
            fails = fails + 1;
        end
        if (fails == 0) $display("COSIM RESULT: PASS");
        else            $display("COSIM RESULT: FAIL (%0d)", fails);
        $finish;
    end

    initial begin
        #80_000_000;   // 80 ms
        $display("COSIM FATAL: timeout");
        $finish;
    end

endmodule
